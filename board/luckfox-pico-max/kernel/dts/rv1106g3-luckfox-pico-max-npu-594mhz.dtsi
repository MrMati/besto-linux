// SPDX-License-Identifier: (GPL-2.0+ OR MIT)
/*
 * Luckfox Pico Max -- run the NPU at 594 MHz instead of the default 500 MHz.
 *
 * Comment the #include of this file out of the board dts to go back to
 * 500 MHz. Nothing else has to change.
 *
 * The NPU's ACLK is a plain gate on aclk_npu_root, and aclk_npu_root is a mux
 * with no divider, so the NPU runs at exactly whatever its selected parent
 * runs at. That parent is clk_500m_src. A rate on ACLK_RKNN cannot move it --
 * a gate has neither .set_rate nor CLK_SET_RATE_PARENT, so the assignment is
 * silently a no-op -- which is why the number has to be set on clk_500m_src
 * and why the &npu line below exists only to keep the two written together.
 * Rockchip's own rv1106g3.dtsi pairs them the same way, at 700 MHz.
 *
 * 594 MHz is GPLL/2 exactly (1188/2). The clock is called clk_500m_src because
 * it comes up on CPLL/2, 1000/2.
 *
 * clk_500m_src also feeds aclk_ddr_root and sclk_sfc, so anything sitting on
 * that leg of their muxes goes up with the NPU. sclk_sfc has its own divider
 * and the SFC driver asks for the rate it wants; aclk_ddr_root does not, but
 * Rockchip run this same clock at 700 MHz on the G3, so 594 is inside what the
 * SoC is expected to take.
 */

/*
 * assigned-clocks replaces the property wholesale rather than appending to it,
 * so rv1106.dtsi's whole list has to be repeated here -- a dropped entry would
 * revert that clock to its boot value. Only CLK_500M_SRC is new.
 *
 * CPLL deliberately stays at 1000 MHz: clk_250m_src, clk_100m_src and
 * clk_50m_src are exact CPLL divisions (/4, /10, /20) and would come out
 * wrong at any other rate.
 */
&cru {
	assigned-clocks =
		<&cru PLL_GPLL>, <&cru PLL_CPLL>,
		<&cru ARMCLK>,
		<&cru ACLK_PERI_ROOT>, <&cru HCLK_PERI_ROOT>,
		<&cru PCLK_PERI_ROOT>, <&cru ACLK_BUS_ROOT>,
		<&cru PCLK_TOP_ROOT>, <&cru PCLK_PMU_ROOT>,
		<&cru HCLK_PMU_ROOT>, <&cru CLK_500M_SRC>;
	assigned-clock-rates =
		<1188000000>, <1000000000>,
		<1104000000>,
		<400000000>, <200000000>,
		<100000000>, <300000000>,
		<100000000>, <100000000>,
		<200000000>, <594000000>;
};

&npu {
	assigned-clock-rates = <594000000>;
};
