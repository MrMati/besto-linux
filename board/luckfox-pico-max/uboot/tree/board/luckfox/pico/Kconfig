## board/luckfox-pico-max/uboot/tree/board/luckfox/pico/Kconfig
```kconfig
if TARGET_LUCKFOX_PICO_RV1103 || TARGET_LUCKFOX_PICO_RV1106

config SYS_BOARD
	default "pico"

config SYS_VENDOR
	default "luckfox"

config SYS_CONFIG_NAME
	default "luckfox_pico"

config LUCKFOX_PICO_DRAM_SIZE_MB
	int "Size of the in-package DRAM, in MB"
	default 64
	help
	  The RV1103/RV1106 DRAM is initialised by the closed-source TPL from
	  rkbin before U-Boot runs and its size is not discoverable from any
	  register U-Boot can rely on, so each board states it here. The Pico
	  Mini has 64MB, the Pico Pro 128MB and the Pico Max 256MB.

endif
```

## board/luckfox-pico-mini/uboot/tree/board/luckfox/pico/Kconfig
```kconfig
if TARGET_LUCKFOX_PICO_RV1103 || TARGET_LUCKFOX_PICO_RV1106

config SYS_BOARD
	default "pico"

config SYS_VENDOR
	default "luckfox"

config SYS_CONFIG_NAME
	default "luckfox_pico"

config LUCKFOX_PICO_DRAM_SIZE_MB
	int "Size of the in-package DRAM, in MB"
	default 64
	help
	  The closed-source TPL initializes RV1103/RV1106 DRAM before U-Boot runs.
	  Its size is board-specific and is not reliably discoverable by U-Boot.

endif
```
